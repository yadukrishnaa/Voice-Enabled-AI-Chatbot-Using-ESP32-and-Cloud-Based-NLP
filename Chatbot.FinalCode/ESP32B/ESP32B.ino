/* ESP32 B
   - Idle: Eye animation
   - Busy: Bitmap animation (Listening & Processing)
   - Audio start: switch to Idle
   - FIXED: Stable TTS playback for unlimited attempts
*/

#include <WiFi.h>
#include <WebServer.h>
#include "Audio.h"
#include <Wire.h>
#include <Adafruit_GFX.h>
#include <Adafruit_SSD1306.h>

// ================= WIFI =================
const char* ssid = "SSID";
const char* password = "PASSWORD";

// ================= AUDIO =================
#define I2S_DOUT 26
#define I2S_BCLK 25
#define I2S_LRC  27

Audio* audio = nullptr;
WebServer server(8000);

// ================= OLED =================
#define SCREEN_WIDTH 128
#define SCREEN_HEIGHT 64
#define OLED_ADDR 0x3C
#define OLED_SDA 21
#define OLED_SCL 22

Adafruit_SSD1306 display(SCREEN_WIDTH, SCREEN_HEIGHT, &Wire, -1);

// ================= BUSY ANIMATION =================
#define FRAME_DELAY 42
#define FRAME_WIDTH 64
#define FRAME_HEIGHT 64

// 🔹 KEEP YOUR frames[][512] ARRAY HERE (UNCHANGED)
const byte PROGMEM frames[][512] = {
  {0,0,0,0,0,0,0,0,0,0,0,0,0,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0,0},
  {0,0,0,0,0,0,0,0,0,0,0,0,0,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0,0},
  {0,0,0,0,0,0,0,0,0,0,0,0,0,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0,0},
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  {0,0,0,0,0,0,0,0,0,0,0,0,0,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0,0}


};
const uint8_t FRAME_COUNT = sizeof(frames) / sizeof(frames[0]);

uint8_t busyFrameIndex = 0;
unsigned long lastBusyFrameTime = 0;

// ================= IDLE EYES =================
int ANIM_DELAY = 60;
const int EH = 40, EW = 40, GAP = 10, RADIUS = 10;

struct EyeState { int h, w, x, y; };
EyeState L, R;
int corner_radius = RADIUS;

unsigned long lastBlink = 0;
unsigned long nextBlinkDelay = 1500;

// ================= STATE =================
bool isBusy = false;

// ================= AUDIO RESET (CRITICAL FIX) =================
void resetAudio() {
  if (audio) {
    delete audio;
  }
  audio = new Audio();
  audio->setPinout(I2S_BCLK, I2S_LRC, I2S_DOUT);
  audio->setVolume(18);   // 🔊 increase if needed (0–21 safe)
}

// ================= OLED HELPERS =================
void initDisplay() {
  Wire.begin(OLED_SDA, OLED_SCL);
  display.begin(SSD1306_SWITCHCAPVCC, OLED_ADDR);
  display.clearDisplay();
  display.setTextColor(SSD1306_WHITE);
}

void resetEyes() {
  L = {EH, EW, SCREEN_WIDTH/2 - EW/2 - GAP/2, SCREEN_HEIGHT/2};
  R = {EH, EW, SCREEN_WIDTH/2 + EW/2 + GAP/2, SCREEN_HEIGHT/2};
  corner_radius = RADIUS;
}

void drawEyes() {
  display.clearDisplay();
  display.fillRoundRect(L.x - L.w/2, L.y - L.h/2, L.w, L.h, corner_radius, SSD1306_WHITE);
  display.fillRoundRect(R.x - R.w/2, R.y - R.h/2, R.w, R.h, corner_radius, SSD1306_WHITE);
  display.display();
}

void blinkEyes() {
  for (int i = 0; i < 3; i++) {
    L.h -= 10; R.h -= 10;
    corner_radius = max(1, L.h/2);
    drawEyes(); delay(ANIM_DELAY);
  }
  for (int i = 0; i < 3; i++) {
    L.h += 10; R.h += 10;
    corner_radius = min(RADIUS, L.h/2);
    drawEyes(); delay(ANIM_DELAY);
  }
}

// ================= BUSY FRAME DRAW =================
void drawBusyFrame() {
  display.clearDisplay();
  display.drawBitmap(
    (SCREEN_WIDTH - FRAME_WIDTH) / 2,
    (SCREEN_HEIGHT - FRAME_HEIGHT) / 2,
    frames[busyFrameIndex],
    FRAME_WIDTH,
    FRAME_HEIGHT,
    1
  );
  display.display();
}

// ================= TTS HELPERS =================
String urlEncode(const String &s) {
  String enc;
  char buf[8];
  for (char c : s) {
    if (isalnum(c)) enc += c;
    else if (c == ' ') enc += "%20";
    else {
      sprintf(buf, "%%%02X", (uint8_t)c);
      enc += buf;
    }
  }
  return enc;
}

String buildTTSUrl(const String &text) {
  return "http://translate.google.com/translate_tts?ie=UTF-8&client=tw-ob&tl=en&q=" +
         urlEncode(text);
}

// ================= HTTP HANDLERS =================
void handleBusy() {
  server.send(200, "text/plain", "OK");
  isBusy = true;
  busyFrameIndex = 0;
  lastBusyFrameTime = 0;
}

void handleIdle() {
  server.send(200, "text/plain", "OK");
  isBusy = false;
  resetEyes();
  drawEyes();
}

void handlePlay() {
  String body = server.arg("plain");
  int i = body.indexOf("\"text\"");
  if (i < 0) {
    server.send(400, "text/plain", "Bad JSON");
    return;
  }
  int s = body.indexOf("\"", i + 6);
  int e = body.indexOf("\"", s + 1);
  String text = body.substring(s + 1, e);

  server.send(200, "text/plain", "Accepted");

  // Switch to IDLE animation BEFORE audio starts
  isBusy = false;
  resetEyes();
  drawEyes();

  // 🔥 CRITICAL FIX: reset Audio BEFORE every play
  resetAudio();
  audio->connecttohost(buildTTSUrl(text).c_str());
}

void handleStop() {
  server.send(200, "text/plain", "Stopped");
  resetAudio();
  isBusy = false;
  resetEyes();
  drawEyes();
}

// ================= SETUP =================
void setup() {
  Serial.begin(115200);

  initDisplay();
  resetEyes();
  drawEyes();

  resetAudio();

  WiFi.begin(ssid, password);
  while (WiFi.status() != WL_CONNECTED) delay(300);

  server.on("/busy", HTTP_POST, handleBusy);
  server.on("/idle", HTTP_POST, handleIdle);
  server.on("/play", HTTP_POST, handlePlay);
  server.on("/stop", HTTP_POST, handleStop);
  server.begin();

  randomSeed(analogRead(34));
}

// ================= LOOP =================
void loop() {
  server.handleClient();

  if (audio && audio->isRunning()) {
    audio->loop();
  }

  unsigned long now = millis();

  if (isBusy) {
    if (now - lastBusyFrameTime >= FRAME_DELAY) {
      lastBusyFrameTime = now;
      drawBusyFrame();
      busyFrameIndex = (busyFrameIndex + 1) % FRAME_COUNT;
    }
  } else {
    if (now - lastBlink >= nextBlinkDelay) {
      blinkEyes();
      lastBlink = now;
      nextBlinkDelay = random(1000, 3000);
    }
  }

  delay(3);
}
